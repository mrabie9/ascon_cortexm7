# file: ascon_cortexm7.ioc
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Mcu.Family=STM32F7
Mcu.Name=STM32F767ZITx
Mcu.Package=LQFP144
NVIC.PriorityGroup=NVIC_PRIORITYGROUP_4
NVIC.TIM6_DAC_IRQn=true\:0\:0\:false\:false\:true\:true\:true\:true
NVIC.TIM7_IRQn=true\:0\:0\:false\:false\:true\:true\:true\:true
PB3.Signal=GPIO_Output
PC14/OSC32_IN.Mode=LSE-External-Oscillator
PC14/OSC32_IN.Signal=RCC_OSC32_IN
PC15/OSC32_OUT.Mode=LSE-External-Oscillator
PC15/OSC32_OUT.Signal=RCC_OSC32_OUT
PH0/OSC_IN.Mode=HSE-External-Oscillator
PH0/OSC_IN.Signal=RCC_OSC_IN
PH1/OSC_OUT.Mode=HSE-External-Oscillator
PH1/OSC_OUT.Signal=RCC_OSC_OUT
ProjectManager.HeapSize=0x200
ProjectManager.StackSize=0x400
ProjectManager.TargetToolchain=STM32CubeIDE
RCC.AHBFreq_Value=16000000
RCC.APB1Freq_Value=16000000
RCC.APB1TimFreq_Value=16000000
RCC.APB2Freq_Value=16000000
RCC.APB2TimFreq_Value=16000000
RCC.CortexFreq_Value=16000000
RCC.HCLKFreq_Value=16000000
RCC.HSE_VALUE=25000000
RCC.HSI_VALUE=16000000
RCC.PLLM=8
RCC.PLLN=216
RCC.SYSCLKFreq_VALUE=16000000
RCC.USBFreq_Value=216000000
RCC.VCOOutputFreq_Value=432000000
TIM6.Prescaler=159
TIM7.Prescaler=159
VP_TIM6_VS_ClockSourceINT.Mode=Enable_Timer
VP_TIM7_VS_ClockSourceINT.Mode=Enable_Timer
board=custom

// file: Core/Src/main.c
/* USER CODE BEGIN Header */
/**
  ******************************************************************************
  * @file           : main.c
  * @brief          : Main program body
  ******************************************************************************
  * @attention
  *
  * Copyright (c) 2023 STMicroelectronics.
  * All rights reserved.
  *
  * This software is licensed under terms that can be found in the LICENSE file
  * in the root directory of this software component.
  * If no LICENSE file comes with this software, it is provided AS-IS.
  *
  ******************************************************************************
  */
/* USER CODE END Header */
#include "main.h"

/* USER CODE BEGIN Includes */

#define ASCON128 0
#define ASCON128A 1
#define TINYJAMBU 2
#define XOODYAK 3
#define MSG_SIZE 16

#define ENCRYPT(a,b,c,d,e,f,g,h,i) crypto_aead_encrypt(a,b,c,d,e,f,g,h,i)
#define DECRYPT(a,b,c,d,e,f,g,h,i) crypto_aead_decrypt(a,b,c,d,e,f,g,h,i)

#define VERSION XOODYAK

#if VERSION == ASCON128
	#include <ASCON-128/aead.h>
#elif VERSION == ASCON128A
	#include <ASCON-128a/aead.h>
#elif VERSION == TINYJAMBU
	#include <lwc_crypto_aead.h>
	#include <TinyJAMBU/api.h>
#elif VERSION == XOODYAK
	#include <Xoodyak/Xoodyak.h>
#endif

/* USER CODE END Includes */

/* USER CODE BEGIN PTD */
//typedef unsigned long long bit64;
/* USER CODE END PTD */

TIM_HandleTypeDef htim6;
TIM_HandleTypeDef htim7;

/* USER CODE BEGIN PV */
int etimer_overflow = -1;
int dtimer_overflow = -1;
/* USER CODE END PV */

void SystemClock_Config(void);
static void MX_GPIO_Init(void);
static void MX_TIM6_Init(void);
static void MX_TIM7_Init(void);

int main(void)
{
  /* USER CODE BEGIN 1 */
	uint32_t timer6_initial = 0, timer6_rem = 0, timer_enc = 0, timer_dec = 0;
	uint32_t timer7_initial = 0, timer7_rem = 0;
  /* USER CODE END 1 */

  /* MCU Configuration--------------------------------------------------------*/

  /* Reset of all peripherals, Initializes the Flash interface and the Systick. */
  HAL_Init();

  /* Configure the system clock */
  SystemClock_Config();

  /* Initialize all configured peripherals */
  MX_GPIO_Init();
  MX_TIM6_Init();
  MX_TIM7_Init();
  /* USER CODE BEGIN 2 */

  volatile unsigned char nonce[CRYPTO_NPUBBYTES] = {0};
  volatile unsigned char key[CRYPTO_KEYBYTES] =  {0};
//  volatile unsigned char nonce[16] = {0}; volatile unsigned char key[16] =  {0};
//#if VERSION == 128
  volatile unsigned char msg[MSG_SIZE] = {0x0};
//#else
//  volatile unsigned char msg[MSG_SIZE] = {
//		  0x01, 0x23, 0x45, 0x67, 0x89, 0xab, 0xcd, 0xef,
//		  0x1, 0x3, 0x5, 0x7, 0x9, 0xb, 0xd, 0xf
//  };
//#endif
  volatile unsigned char dt[MSG_SIZE] = {0};
  volatile uint64_t msglen = sizeof(msg)/sizeof(unsigned char);
  volatile unsigned long long ctlen = 0;
  volatile unsigned char ct[MSG_SIZE + CRYPTO_ABYTES] = {0};
  volatile unsigned long long adlen = 0;

  // Declare pointers
  volatile unsigned char *c;
  volatile unsigned long long *clen;
  volatile uint64_t *mlen;
  volatile unsigned char * dm;
  volatile unsigned char *k, *npub;
  volatile unsigned char *m;

  // Initialise pointers
  k = key;
  npub = nonce;
  mlen = &msglen;
  clen = &ctlen;
  m = msg;
  dm = dt;
  c = ct;

  // Encrypt
  HAL_TIM_Base_Start_IT(&htim6);
  timer6_initial = __HAL_TIM_GET_COUNTER(&htim6);
  ENCRYPT(c, clen, m, msglen, NULL, adlen, NULL, npub, k);
  timer6_rem = __HAL_TIM_GET_COUNTER(&htim6);
  if(etimer_overflow){
	  int temp;
	  temp = 65535 - timer6_initial;
	  etimer_overflow--;
	  timer_enc = temp + timer6_rem + etimer_overflow*65535;
  } else {
	  timer_enc = timer6_rem;
  }

  // Decrypt
  HAL_TIM_Base_Start_IT(&htim7);
  timer7_initial = __HAL_TIM_GET_COUNTER(&htim7);
  DECRYPT(dm, mlen, NULL, c, ctlen, NULL, adlen, npub, k);
  timer7_rem = __HAL_TIM_GET_COUNTER(&htim7);
  if(dtimer_overflow){
	  int temp;
	  temp = 65535 - timer7_initial;
	  dtimer_overflow--;
	  timer_dec = temp + timer7_rem + dtimer_overflow*65535;
  } else {
	  timer_dec = timer7_rem;
  }

  /* USER CODE END 2 */

  /* Infinite loop */
  while (1)
  {

  }
}

void SystemClock_Config(void)
{
  RCC_OscInitTypeDef RCC_OscInitStruct = {0};
  RCC_ClkInitTypeDef RCC_ClkInitStruct = {0};

  /** Configure LSE Drive Capability
  */
  HAL_PWR_EnableBkUpAccess();

  /** Configure the main internal regulator output voltage
  */
  __HAL_RCC_PWR_CLK_ENABLE();
  __HAL_PWR_VOLTAGESCALING_CONFIG(PWR_REGULATOR_VOLTAGE_SCALE3);

  /** Initializes the RCC Oscillators according to the specified parameters
  * in the RCC_OscInitTypeDef structure.
  */
  RCC_OscInitStruct.OscillatorType = RCC_OSCILLATORTYPE_HSI;
  RCC_OscInitStruct.HSIState = RCC_HSI_ON;
  RCC_OscInitStruct.HSICalibrationValue = RCC_HSICALIBRATION_DEFAULT;
  RCC_OscInitStruct.PLL.PLLState = RCC_PLL_NONE;
  if (HAL_RCC_OscConfig(&RCC_OscInitStruct) != HAL_OK)
  {
    Error_Handler();
  }

  /** Initializes the CPU, AHB and APB buses clocks
  */
  RCC_ClkInitStruct.ClockType = RCC_CLOCKTYPE_HCLK|RCC_CLOCKTYPE_SYSCLK
                              |RCC_CLOCKTYPE_PCLK1|RCC_CLOCKTYPE_PCLK2;
  RCC_ClkInitStruct.SYSCLKSource = RCC_SYSCLKSOURCE_HSI;
  RCC_ClkInitStruct.AHBCLKDivider = RCC_SYSCLK_DIV1;
  RCC_ClkInitStruct.APB1CLKDivider = RCC_HCLK_DIV1;
  RCC_ClkInitStruct.APB2CLKDivider = RCC_HCLK_DIV1;

  if (HAL_RCC_ClockConfig(&RCC_ClkInitStruct, FLASH_LATENCY_0) != HAL_OK)
  {
    Error_Handler();
  }
}

static void MX_TIM6_Init(void)
{

  TIM_MasterConfigTypeDef sMasterConfig = {0};

  htim6.Instance = TIM6;
  htim6.Init.Prescaler = 319;
  htim6.Init.CounterMode = TIM_COUNTERMODE_UP;
  htim6.Init.Period = 65535;
  htim6.Init.AutoReloadPreload = TIM_AUTORELOAD_PRELOAD_DISABLE;
  if (HAL_TIM_Base_Init(&htim6) != HAL_OK)
  {
    Error_Handler();
  }
  sMasterConfig.MasterOutputTrigger = TIM_TRGO_RESET;
  sMasterConfig.MasterSlaveMode = TIM_MASTERSLAVEMODE_DISABLE;
  if (HAL_TIMEx_MasterConfigSynchronization(&htim6, &sMasterConfig) != HAL_OK)
  {
    Error_Handler();
  }

}

static void MX_TIM7_Init(void)
{

  TIM_MasterConfigTypeDef sMasterConfig = {0};

  htim7.Instance = TIM7;
  htim7.Init.Prescaler = 319;
  htim7.Init.CounterMode = TIM_COUNTERMODE_UP;
  htim7.Init.Period = 65535;
  htim7.Init.AutoReloadPreload = TIM_AUTORELOAD_PRELOAD_DISABLE;
  if (HAL_TIM_Base_Init(&htim7) != HAL_OK)
  {
    Error_Handler();
  }
  sMasterConfig.MasterOutputTrigger = TIM_TRGO_RESET;
  sMasterConfig.MasterSlaveMode = TIM_MASTERSLAVEMODE_DISABLE;
  if (HAL_TIMEx_MasterConfigSynchronization(&htim7, &sMasterConfig) != HAL_OK)
  {
    Error_Handler();
  }

}

static void MX_GPIO_Init(void)
{
  GPIO_InitTypeDef GPIO_InitStruct = {0};

  /* GPIO Ports Clock Enable */
  __HAL_RCC_GPIOC_CLK_ENABLE();
  __HAL_RCC_GPIOH_CLK_ENABLE();
  __HAL_RCC_GPIOB_CLK_ENABLE();

  /*Configure GPIO pin Output Level */
  HAL_GPIO_WritePin(GPIOB, GPIO_PIN_3, GPIO_PIN_RESET);

  /*Configure GPIO pin : PB3 */
  GPIO_InitStruct.Pin = GPIO_PIN_3;
  GPIO_InitStruct.Mode = GPIO_MODE_OUTPUT_PP;
  GPIO_InitStruct.Pull = GPIO_NOPULL;
  GPIO_InitStruct.Speed = GPIO_SPEED_FREQ_LOW;
  HAL_GPIO_Init(GPIOB, &GPIO_InitStruct);

}

/* USER CODE BEGIN 4 */
void HAL_TIM_PeriodElapsedCallback(TIM_HandleTypeDef *htim)
{
  // Check which version of the timer triggered this callback and toggle LED
  if (htim == &htim6 )
  {
	  etimer_overflow++;
  }

  // Check which version of the timer triggered this callback and toggle LED
  else if (htim == &htim7 )
  {
	  dtimer_overflow++;
  }
}

/* USER CODE END 4 */

void Error_Handler(void)
{
  __disable_irq();
  while (1)
  {
  }
}
